/**
  ******************************************************************************
  * @file    drv_motor.c
  * @brief   M3508 速度环实现
  *
  *  ★ 本文件里没有一句"花活"：
  *    每个变量单独声明、每个数字都有来历、
  *    每个 if 后面都写了"为什么这么判断"。
  ******************************************************************************
  */
#include "drv_motor.h"
#include "config.h"     /* PID 参数、电流上限 */
#include <math.h>       /* fabsf：求浮点数的绝对值 */
#include <string.h>     /* memset：把一块内存全部清 0 */

/* 4 个电机对象。
 * static 表示"只有本文件能访问"，
 * 别的 .c 文件只能用 Motor_Get() 拿到指针。
 * 这样外面就没法乱改数组下标，也不会出现
 * "某某文件 extern 了一个电机变量然后到处乱写"的情况。 */
static Motor_t s_motor[DRIVE_MOTOR_NUM];

/* ============================================================================
 *  Motor_Get —— 按编号取电机对象
 *  调用者：task_chassis.c
 * ==========================================================================*/
Motor_t *Motor_Get(uint8_t idx)
{
    /* 越界检查：编号必须小于 4 */
    if (idx >= DRIVE_MOTOR_NUM)
    {
        return 0;              /* 0 就是 NULL，表示"没有这个电机" */
    }
    return &s_motor[idx];      /* & 是"取地址"，返回这个电机所在的内存地址 */
}

/* ============================================================================
 *  Motor_Init —— 初始化
 *  调用者：task_chassis.c 的 Task_Chassis_Init()
 * ==========================================================================*/
void Motor_Init(uint8_t idx, float kp, float ki, float kd)
{
    Motor_t *m;

    m = Motor_Get(idx);
    if (m == 0)
    {
        return;                /* 编号不对，什么都不做 */
    }

    /* 把整块内存清 0：
     * target_rpm / actual_rpm / integral / give_current 全部变成 0。
     * ★ 上电时这一步特别重要。
     *   如果 integral 不清零，它会带着内存里的随机值继续累积，
     *   车一上电就自己跑。 */
    memset(m, 0, sizeof(Motor_t));

    /* 再把 PID 参数填进去 */
    m->kp = kp;
    m->ki = ki;
    m->kd = kd;

    /* 记一下"现在"的时刻，免得刚上电就被判成掉线 */
    m->last_rx_tick = HAL_GetTick();
}

/* ============================================================================
 *  Motor_UpdateFeedback —— 中断里写反馈
 *  调用者：bsp_can.c 的 HAL_CAN_RxFifo0MsgPendingCallback()，每秒约 2000 次
 *
 *  ★ 这里一个除法都没有，也不调任何耗时函数。
 *    中断里做重活会拖慢整个系统。
 * ==========================================================================*/
void Motor_UpdateFeedback(uint8_t idx, int16_t rotor_rpm,
                          int16_t torque, uint8_t temp)
{
    Motor_t *m;

    m = Motor_Get(idx);
    if (m == 0)
    {
        return;
    }

    /* 电调给的 rpm 是整数，转成浮点存起来。
     * 这就是"转子 rpm"的本体，PID 直接用，不换算。 */
    m->actual_rpm = rotor_rpm;

    /* 下面两个只留着调试看，不参与控制 */
    m->torque_cur = torque;
    m->temperature = temp;

    /* 记录时刻，供掉线检测用 */
    m->last_rx_tick = HAL_GetTick();
    m->online = 1;
}

/* ============================================================================
 *  Motor_CheckOnline —— 掉线检测
 *  调用者：freertos.c 的 StartDefaultTask()，每 10ms 一次
 * ==========================================================================*/
void Motor_CheckOnline(uint32_t now_tick)
{
    uint8_t i;
    uint32_t elapsed;

    for (i = 0; i < DRIVE_MOTOR_NUM; i++)
    {
        /* 算"距离上次收到反馈过了多久"。
         * 用无符号减法：即使 HAL_GetTick() 溢出（开机 49 天后）也不会算错，
         * 这是嵌入式里的标准写法。 */
        elapsed = now_tick - s_motor[i].last_rx_tick;

        if (elapsed < 50)
        {
            s_motor[i].online = 1;      /* 50ms 内还有反馈 -> 在线 */
        }
        else
        {
            s_motor[i].online = 0;      /* 超过 50ms 没反馈 -> 掉线 */
        }
    }
}

/* ============================================================================
 *  Motor_Speed_PID_Calc —— 速度环核心
 *  调用者：task_chassis.c 的 Task_Chassis_Loop()，1kHz，dt = 0.001f
 *
 * ----------------------------------------------------------------------------
 *  一、PID 到底在算什么？
 * ----------------------------------------------------------------------------
 *  误差 = 目标转速 - 实际转速
 *     误差 > 0：实际比目标慢 -> 要加速 -> 输出正电流
 *     误差 < 0：实际比目标快 -> 要减速 -> 输出负电流（反向制动）
 *     误差 = 0：正好，不用动
 *
 *  输出 = KP × 误差  +  KI × (误差的累积)  +  KD × (误差的变化)
 *           ↑            ↑                      ↑
 *         立刻出多少力   慢慢补掉小差距           预判，防止冲过头
 *
 *  本例只用 P 和 I（速度环基本不用 D）。
 *
 * ----------------------------------------------------------------------------
 *  二、为什么要限幅？
 * ----------------------------------------------------------------------------
 *  电机只能接受 -16384 ~ +16384 的电流，超了没意义。
 *  而且如果不管的话，误差大的时候积分会累积到天文数字，
 *  等你松手时它要很久才能"退"回来，车会冲出去 —— 这叫积分饱和。
 *  所以要：积分限幅 + 输出限幅 + 饱和时把积分往回扣。
 * ----------------------------------------------------------------------------
 *
 *  @param  m   要算的电机
 *  @param  dt  距离上次算过了多少秒
 *  @retval 无（结果写进 m->give_current）
 * ==========================================================================*/
void Motor_Speed_PID_Calc(Motor_t *m, float dt)
{
    float err;          /* 误差 */
    float i_max;        /* 积分允许的最大值 */
    float out;          /* 算出来的输出 */

    if (m == 0)
    {
        return;                            /* 空指针，直接返回 */
    }

    /* dt 防呆：万一传进来 0 或者特别大的数（说明任务调度出问题了），
     * 就强制用 1ms，避免算出天文数字。 */
    if (dt <= 0.0f || dt > 0.1f)
    {
        dt = 0.001f;
    }

    /* ---- 第 1 步：算误差 ---- */
    err = m->target_rpm - m->actual_rpm;

    /* ---- 第 2 步：算积分 ----
     * 积分就是"误差 × 时间"，一直累加。
     * 为什么乘 dt？不乘的话，循环跑得越快积分涨得越快，
     * 你换个采样频率整个参数就全变了。 */
    if (fabsf(err) > 5.0f)
    {
        /* 【积分分离】误差小于 5 rpm 时不积分。
         * 因为这点小误差靠 P 项就够了，
         * 一直积分反而会让输出左右抖。 */
        m->integral = m->integral + err * dt;
    }

    /* ---- 第 3 步：积分限幅 ----
     * 让积分项单独最多只能贡献"输出上限的一半"，
     * 这样即使积分攒满了，也还留一半余量给 P 项去紧急调整。
     *
     * 为什么除以 ki？因为输出的时候要乘回 ki：
     *     积分项贡献 = ki × integral
     * 要让它等于 输出上限的一半：
     *     ki × integral = 上限/2
     *     integral = 上限/2/ki
     */
    if (m->ki > 0.0001f)
    {
        i_max = 0.5f * DRIVE_CURRENT_MAX / m->ki;
    }
    else
    {
        i_max = 0.0f;          /* ki 是 0 的话积分没用，直接压成 0 */
    }

    if (m->integral > i_max)
    {
        m->integral = i_max;
    }
    if (m->integral < -i_max)
    {
        m->integral = -i_max;
    }

    /* ---- 第 4 步：算输出 ---- */
    out = m->kp * err + m->ki * m->integral;

    /* ---- 第 5 步：输出限幅 ---- */
    if (out > DRIVE_CURRENT_MAX)
    {
        out = DRIVE_CURRENT_MAX;
    }
    if (out < -DRIVE_CURRENT_MAX)
    {
        out = -DRIVE_CURRENT_MAX;
    }

    /* ---- 第 6 步：抗积分饱和 ----
     * 如果输出已经顶到上限，而误差还想让它更大（同一个方向），
     * 说明"再怎么加也没用了"，此时把刚加进去的积分退回来。
     *
     * 不做这一步会怎样？
     * 车从静止加速到高速的过程中，积分会攒满，
     * 到目标速度时收不住，会冲过头很多。 */
    if (out >= DRIVE_CURRENT_MAX && err > 0.0f)
    {
        m->integral = m->integral - err * dt;
    }
    if (out <= -DRIVE_CURRENT_MAX && err < 0.0f)
    {
        m->integral = m->integral - err * dt;
    }

    /* ---- 第 7 步：记住这次的误差（只有用 KD 时才需要）---- */
    m->last_error = err;

    /* ---- 第 8 步：把浮点结果转成整数存起来，准备发出去 ---- */
    m->give_current = out;
}
