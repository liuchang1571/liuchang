/**
  ******************************************************************************
  * @file    bsp_rc.c
  * @brief   遥控器接收的实现（DMA + 空闲中断）
  *
  *  本文件所有函数"在哪被调用"，头文件 bsp_rc.h 里都写了。
  *  这里只讲"怎么实现的"。
  *
  *  ★ 写作约定（为了让你看得懂）：
  *    - 一个语句只做一件事
  *    - 先把要用的变量全部声明在函数最开头
  *    - 不用复杂的三目运算符、不用花里胡哨的强转
  ******************************************************************************
  */
#include "bsp_rc.h"
#include "usart.h"      /* huart3（CubeMX 在 usart.c 里定义的串口句柄） */
#include <string.h>     /* memcpy */

/* ============================================================================
 *  4 个文件内部使用的变量（static = 别的 .c 文件看不见，也改不了）
 * ==========================================================================*/

/* DMA 搬数据的落点。
 * 串口每来一个字节，DMA 硬件就往这里写一个，写的位置自动往后走。
 * ★ 这一块【只由 DMA 硬件写】，其他代码谁都不许碰。 */
static uint8_t s_dma_buf[DBUS_LEN];

/* 影子缓冲。
 * 中断把 s_dma_buf 整个拷过来，任务只读这一块。
 * 这样任务永远读不到"正在被 DMA 改写"的数据。 */
static uint8_t s_frame[DBUS_LEN];

/* "有新数据"标志。
 * 中断里置 1，任务拿走之后清 0。
 * ★ 必须加 volatile：它在中断里被写、在任务里被读，
 *   不加的话编译器可能优化成"只读一次"，任务就永远看不到变化。 */
static volatile uint8_t s_new_frame = 0;

/* 最后一帧到达的时刻（毫秒）。关控判断就看它。 */
static volatile uint32_t s_last_tick = 0;

/* 半帧 / 错帧计数。收到不足 18 字节就丢弃，这里 +1。 */
static volatile uint16_t s_drop_cnt = 0;

/* ============================================================================
 *  RC_StartRx —— 内部用的"启动一次接收"
 * ----------------------------------------------------------------------------
 *  为什么单独写一个函数？
 *  因为 DMA 是"单次模式"：收满 18 字节它就自动停了。
 *  所以每收完一帧都要重新启动一次，
 *  把这段启动代码抽成函数，免得写两遍、漏改一处。
 *
 *  调用位置：
 *      BSP_RC_Init()         开机第一次启动
 *      BSP_RC_IrqHandler()   收完一帧后重启
 *      BSP_RC_IrqHandler()   串口出错后重启
 * ==========================================================================*/
static void RC_StartRx(void)
{
    /* 第 1 句：启动 DMA 接收。
     * HAL_UART_Receive_DMA 内部做了三件事：
     *   1) 把串口的接收状态设成"忙"
     *   2) 打开串口的 DMA 接收开关
     *   3) 启动 DMA 通道，让它盯着串口数据寄存器
     * 从这一刻起，串口收到的每个字节都由 DMA 自动搬进 s_dma_buf。 */
    HAL_UART_Receive_DMA(&huart3, s_dma_buf, DBUS_LEN);

    /* 第 2 句：打开"空闲中断"。
     * 串口有很多种中断：收到字节中断、发送完成中断、空闲中断……
     * 这句只打开"空闲中断"（IDLE），意思是：
     *   "数据线连续空闲超过 1 个字节的时间，就打断我一下"
     * 这就是我们判断"一帧结束"的信号。 */
    __HAL_UART_ENABLE_IT(&huart3, UART_IT_IDLE);
}

/* ============================================================================
 *  BSP_RC_Init —— 开机初始化，只调用一次
 *  调用者：task_rc.c 的 Task_RC_Init()  <-  freertos.c 的 Init_Task
 * ==========================================================================*/
void BSP_RC_Init(void)
{
    RC_StartRx();
}

/* ============================================================================
 *  BSP_RC_IrqHandler —— 串口3中断里做的工作
 *  调用者：Core/Src/stm32f4xx_it.c 的 USART3_IRQHandler()，每 14ms 一次
 *
 *  一次中断要做 7 件事，按顺序：
 *     ① 确认是不是"空闲中断"
 *     ② 清掉空闲标志（否则会一直重复进中断，程序卡死）
 *     ③ 算出这次收了多少字节
 *     ④ 停掉 DMA
 *     ⑤ 只有收满 18 字节才拷到影子缓冲
 *     ⑥ 记录时间戳
 *     ⑦ 重启 DMA，准备下一帧
 * ==========================================================================*/
void BSP_RC_IrqHandler(void)
{
    uint16_t remain;    /* DMA 还剩几个字节没搬 */
    uint16_t len;       /* 这次实际收了几个字节 */

    /* ---------- 情况 1：空闲中断（正常收完一帧走这里）---------- */
    if (__HAL_UART_GET_FLAG(&huart3, UART_FLAG_IDLE) != RESET)
    {
        /* ② 清掉空闲标志。
         * 这个标志要靠"读状态寄存器、再读数据寄存器"来清除，
         * HAL 把它封装成了 __HAL_UART_CLEAR_IDLEFLAG 这个宏。
         * ★ 这一步绝对不能漏！不清的话中断标志一直挂着，
         *   程序会无限次重新进入这个函数，主程序直接卡死。 */
        __HAL_UART_CLEAR_IDLEFLAG(&huart3);

        /* ③ 算出这次收了多少字节。
         * 说明：DMA 的计数器记的是"还剩几个字节没搬"。
         *       启动时设的是 18，搬了 5 个就剩 13，
         *       所以：已收字节数 = 18 - 剩余数。
         * ★ 必须在停 DMA 之前读！停了之后这个数就不准了。 */
        remain = __HAL_DMA_GET_COUNTER(huart3.hdmarx);
        len = DBUS_LEN - remain;

        /* ④ 停掉这次 DMA 接收。
         * 这个函数会：关掉串口的 DMA 开关、中止 DMA 通道、
         *            把接收状态复位成"空闲"。
         * 只有这样，下次才能重新启动。 */
        HAL_UART_DMAStop(&huart3);

        /* ⑤ 长度校验：只有收满 18 字节才认为是一帧有效数据 */
        if (len == DBUS_LEN)
        {
            /* 把整帧从 DMA 缓冲拷到影子缓冲。
             * 从这一刻起，任务读 s_frame 就是完整、稳定的 18 字节。 */
            memcpy(s_frame, s_dma_buf, DBUS_LEN);

            /* ⑥ 记录时间戳。
             * task_rc.c 会用 "现在的时间 - 这个值 > 21" 来判断关控。 */
            s_last_tick = HAL_GetTick();

            /* 按门铃：告诉任务"有新数据了" */
            s_new_frame = 1;
        }
        else
        {
            /* 收到的不是完整一帧
             * （比如上电瞬间、插拔接收机、线上有干扰），
             * 直接丢弃，计数 +1 方便调试。
             * 下一帧会从完整的地方重新开始，自动对齐。 */
            s_drop_cnt = s_drop_cnt + 1;
        }

        /* ⑦ 重新启动接收，准备下一帧。
         * ★ 这一步绝对不能漏！DMA 是单次模式，收满就停了。
         *   不重启的话，你只能收到上电后的第一帧，之后永远没数据。 */
        RC_StartRx();
    }

    /* ---------- 情况 2：串口出错自愈 ---------- */
    /* 100kbps 的线如果比较长、或者有干扰，很容易出现两种错误：
     *    ORE（溢出）：CPU 没来得及取数据，新数据把旧的覆盖了
     *    FE（帧错误）：波形不规整，停止位不对
     * 出错之后串口会"卡住"不再接收，必须清标志并重启。 */
    if (__HAL_UART_GET_FLAG(&huart3, UART_FLAG_ORE) != RESET ||
        __HAL_UART_GET_FLAG(&huart3, UART_FLAG_FE) != RESET)
    {
        __HAL_UART_CLEAR_PEFLAG(&huart3);    /* 清错误标志 */
        HAL_UART_DMAStop(&huart3);           /* 停掉已经乱掉的接收 */
        RC_StartRx();                        /* 重新开始 */
    }
}

/* ============================================================================
 *  BSP_RC_GetFrame —— 把影子缓冲的地址交出去
 *  调用者：task_rc.c 的 Task_RC_Loop()
 * ==========================================================================*/
const uint8_t *BSP_RC_GetFrame(void)
{
    return s_frame;
}

/* ============================================================================
 *  BSP_RC_TakeNewFrame —— 问"有没有新数据"，并清零
 *  调用者：task_rc.c 的 Task_RC_Loop()，1kHz
 * ==========================================================================*/
uint8_t BSP_RC_TakeNewFrame(void)
{
    uint8_t flag;

    flag = s_new_frame;     /* 先把标志读出来存着 */
    s_new_frame = 0;        /* 立刻清零（这样同一帧不会被处理两次） */
    return flag;            /* 返回刚才读到的值 */
}

/* ============================================================================
 *  BSP_RC_GetLastTick —— 最后一帧的时刻
 *  调用者：task_rc.c，用来算"现在 - 最后时刻"是否超过 21ms
 * ==========================================================================*/
uint32_t BSP_RC_GetLastTick(void)
{
    return s_last_tick;
}

/* ============================================================================
 *  BSP_RC_GetDropCount —— 半帧累计数（调试用）
 *  调用者：task_rc.c
 * ==========================================================================*/
uint16_t BSP_RC_GetDropCount(void)
{
    return s_drop_cnt;
}
